## platformio/projects/wemos_lolin32_ble_adc_streaming_espidf/sdkconfig.defaults
```kconfig
# Enable NimBLE host stack
CONFIG_BT_ENABLED=y
CONFIG_BT_NIMBLE_ENABLED=y
CONFIG_BT_NIMBLE_ROLE_PERIPHERAL=y

# Set the GAP device name
CONFIG_BT_NIMBLE_SVC_GAP_DEVICE_NAME="ESP32-BLE-ADC-Minimal"

# Disable bonding and security
CONFIG_BT_NIMBLE_SM_LEGACY=y
CONFIG_BT_NIMBLE_SM_SC_ONLY=n
CONFIG_BT_NIMBLE_SM_BONDING=n
CONFIG_BT_NIMBLE_SM_AUTHREQ_NO_BOND=y

# Reduce memory footprint
CONFIG_BT_NIMBLE_TASK_STACK_SIZE=1024
CONFIG_BT_NIMBLE_HCI_EVT_BUF_SIZE=70
CONFIG_BT_NIMBLE_MAX_CONNECTIONS=1
CONFIG_BT_NIMBLE_MAX_BONDS=1

# Disable persistent NVS storage for security keys
CONFIG_BT_NIMBLE_NVS_PERSIST=n

# Disable logging if not debugging BLE internals
CONFIG_BT_NIMBLE_DEBUG=n
```
